## Config.in
```kconfig
source "$BR2_EXTERNAL_EXT_PATH/package/python-streaming-form-data/Config.in"
source "$BR2_EXTERNAL_EXT_PATH/package/python-smart-open/Config.in"
source "$BR2_EXTERNAL_EXT_PATH/package/python-inotify-simple/Config.in"
source "$BR2_EXTERNAL_EXT_PATH/package/python-libnacl/Config.in"
source "$BR2_EXTERNAL_EXT_PATH/package/klipper3d/Config.in"
source "$BR2_EXTERNAL_EXT_PATH/package/klipper3d-moonraker/Config.in"
source "$BR2_EXTERNAL_EXT_PATH/package/klipper3d-mainsail/Config.in"
source "$BR2_EXTERNAL_EXT_PATH/package/klipper3d-wrecklab/Config.in"
source "$BR2_EXTERNAL_EXT_PATH/package/klipper3d-repl/Config.in"
```

## configs/miot_rpi4_5.10_rt_defconfig
```kconfig
BR2_arm=y
BR2_cortex_a72=y
BR2_ARM_FPU_NEON_VFPV4=y
BR2_PACKAGE_HOST_LINUX_HEADERS_CUSTOM_5_10=y
BR2_TOOLCHAIN_BUILDROOT_CXX=y
BR2_ROOTFS_DEVICE_CREATION_DYNAMIC_MDEV=y
BR2_SYSTEM_DHCP="eth0"
BR2_ROOTFS_USERS_TABLES="$(BR2_EXTERNAL)/board/users.txt"
BR2_ROOTFS_OVERLAY="$(BR2_EXTERNAL)/board/bfg/miot_rpi4/rootfs"
BR2_ROOTFS_POST_BUILD_SCRIPT="board/raspberrypi4/post-build.sh"
BR2_ROOTFS_POST_IMAGE_SCRIPT="board/raspberrypi4/post-image.sh"
BR2_LINUX_KERNEL=y
BR2_LINUX_KERNEL_CUSTOM_GIT=y
BR2_LINUX_KERNEL_CUSTOM_REPO_URL="https://github.com/raspberrypi/linux.git"
BR2_LINUX_KERNEL_CUSTOM_REPO_VERSION="stable_20211118"
BR2_LINUX_KERNEL_PATCH="https://cdn.kernel.org/pub/linux/kernel/projects/rt/5.10/older/patch-5.10.59-rt52.patch.xz"
BR2_LINUX_KERNEL_DEFCONFIG="bcm2711"
BR2_LINUX_KERNEL_CONFIG_FRAGMENT_FILES="../buildroot-bfg/board/linux-rt.config"
BR2_LINUX_KERNEL_DTS_SUPPORT=y
BR2_LINUX_KERNEL_INTREE_DTS_NAME="bcm2711-rpi-4-b"
BR2_LINUX_KERNEL_NEEDS_HOST_OPENSSL=y
BR2_PACKAGE_BRCMFMAC_SDIO_FIRMWARE_RPI=y
BR2_PACKAGE_BRCMFMAC_SDIO_FIRMWARE_RPI_WIFI=y
BR2_PACKAGE_RPI_FIRMWARE=y
BR2_PACKAGE_RPI_FIRMWARE_VARIANT_PI4=y
BR2_PACKAGE_RPI_FIRMWARE_CONFIG_FILE="board/raspberrypi4/config_4.txt"
BR2_PACKAGE_LIBNL=y
BR2_PACKAGE_DROPBEAR=y
BR2_PACKAGE_IWD=y
BR2_TARGET_ROOTFS_EXT2=y
BR2_TARGET_ROOTFS_EXT2_4=y
BR2_TARGET_ROOTFS_EXT2_SIZE="120M"
# BR2_TARGET_ROOTFS_TAR is not set
BR2_PACKAGE_HOST_DOSFSTOOLS=y
BR2_PACKAGE_HOST_GENIMAGE=y
BR2_PACKAGE_HOST_MTOOLS=y
```

## configs/raspberrypi5_qt5_cv_defconfig
```kconfig
BR2_aarch64=y
BR2_cortex_a76=y
BR2_ARM_FPU_NEON_VFPV4=y

BR2_TOOLCHAIN_BUILDROOT_CXX=y

BR2_SYSTEM_DHCP="eth0"

BR2_PACKAGE_HOST_LINUX_HEADERS_CUSTOM_6_1=y

BR2_LINUX_KERNEL=y
BR2_LINUX_KERNEL_CUSTOM_TARBALL=y
#BR2_LINUX_KERNEL_CUSTOM_TARBALL_LOCATION="https://github.com/raspberrypi/linux/archive/stable_20240124.tar.gz"
BR2_LINUX_KERNEL_CUSTOM_TARBALL_LOCATION="$(call github,raspberrypi,linux,17f135b742c4edb340afb365873c3a574f7e16cb)/linux-17f135b742c4edb340afb365873c3a574f7e16cb.tar.gz"
BR2_LINUX_KERNEL_DEFCONFIG="bcm2712"

# Build RT kernel
#BR2_LINUX_KERNEL_PATCH="https://cdn.kernel.org/pub/linux/kernel/projects/rt/5.10/older/patch-5.10.59-rt52.patch.xz"
#BR2_LINUX_KERNEL_CONFIG_FRAGMENT_FILES="$(BR2_EXTERNAL)/board/raspberrypi-rt/linux.config"
#BR2_PACKAGE_RT_TESTS=y

BR2_LINUX_KERNEL_DTS_SUPPORT=y
BR2_LINUX_KERNEL_INTREE_DTS_NAME="broadcom/bcm2712-rpi-5-b"
BR2_LINUX_KERNEL_NEEDS_HOST_OPENSSL=y

BR2_PACKAGE_RPI_FIRMWARE=y
BR2_PACKAGE_RPI_FIRMWARE_VARIANT_PI4=y
BR2_PACKAGE_RPI_FIRMWARE_CONFIG_FILE="$(BR2_EXTERNAL)/board/raspberrypi5/config_5.txt"

# Required tools to create the SD image
BR2_PACKAGE_HOST_DOSFSTOOLS=y
BR2_PACKAGE_HOST_GENIMAGE=y
BR2_PACKAGE_HOST_MTOOLS=y

BR2_TARGET_ROOTFS_EXT2=y
BR2_TARGET_ROOTFS_EXT2_4=y
BR2_TARGET_ROOTFS_EXT2_SIZE="512M"
# BR2_TARGET_ROOTFS_TAR is not set
BR2_ROOTFS_POST_BUILD_SCRIPT="$(BR2_EXTERNAL)/board/raspberrypi5/post-build.sh"
BR2_ROOTFS_POST_IMAGE_SCRIPT="$(BR2_EXTERNAL)/board/raspberrypi5/post-image.sh"

# Enable compressed kernel module support
BR2_PACKAGE_BUSYBOX_SHOW_OTHERS=y
BR2_PACKAGE_KMOD_TOOLS=y
BR2_PACKAGE_XZ=y
BR2_PACKAGE_KMOD=y
BR2_PACKAGE_HOST_KMOD_XZ=y



### Extra, Qt and CV

BR2_ROOTFS_USERS_TABLES="$(BR2_EXTERNAL)/board/raspberrypi-qt5rpi/users.config"
BR2_ROOTFS_OVERLAY="$(BR2_EXTERNAL)/board/raspberrypi-qt5rpi/rootfs"

BR2_PACKAGE_BRCMFMAC_SDIO_FIRMWARE_RPI=y
BR2_PACKAGE_BRCMFMAC_SDIO_FIRMWARE_RPI_WIFI=y
# Target Packages -> Libraries
BR2_PACKAGE_OPENCV4=y
BR2_PACKAGE_OPENCV4_LIB_OBJDETECT=y
BR2_PACKAGE_OPENCV4_LIB_SHAPE=y
BR2_PACKAGE_OPENCV4_LIB_VIDEOIO=y
BR2_PACKAGE_OPENCV4_WITH_GSTREAMER1=y
BR2_PACKAGE_OPENCV4_WITH_TBB=y
# Target Packages -> Libraries -> MHardware handling
BR2_PACKAGE_LIBINPUT=y
BR2_PACKAGE_LIBV4L=y
BR2_PACKAGE_LIBV4L_UTILS=y
BR2_PACKAGE_LIBXKBCOMMON=y
BR2_PACKAGE_LIBXKBCOMMON_TOOLS=y
# Target Packages -> Libraries -> Multimedia
BR2_PACKAGE_LIBCAMERA=y
BR2_PACKAGE_LIBCAMERA_V4L2=y
BR2_PACKAGE_LIBCAMERA_PIPELINE_RPI_VC4=y
# Target Packages -> Libraries -> JSON/XML
BR2_PACKAGE_JANSSON=y
# Target Packages -> Libraries -> Text and terminal handling
BR2_PACKAGE_READLINE=y
# Target Packages -> Miscellaneous
BR2_PACKAGE_XUTIL_UTIL_MACROS=y
# Target Packages -> Graphics libraries and applications
BR2_PACKAGE_MESA3D=y
BR2_PACKAGE_MESA3D_GALLIUM_DRIVER_SWRAST=y
BR2_PACKAGE_MESA3D_GALLIUM_DRIVER_V3D=y
BR2_PACKAGE_MESA3D_OPENGL_ES=y
BR2_PACKAGE_QT5=y
BR2_PACKAGE_QT5BASE_GUI=y
BR2_PACKAGE_QT5BASE_EGLFS=y
BR2_PACKAGE_QT5BASE_FONTCONFIG=y
BR2_PACKAGE_QT5BASE_GIF=y
BR2_PACKAGE_QT5BASE_JPEG=y
BR2_PACKAGE_QT5BASE_PNG=y
BR2_PACKAGE_QT5BASE_TSLIB=y
BR2_PACKAGE_QT5CHARTS=y
BR2_PACKAGE_QT5GRAPHICALEFFECTS=y
BR2_PACKAGE_QT5IMAGEFORMATS=y
BR2_PACKAGE_QT5MULTIMEDIA=y
BR2_PACKAGE_QT5QUICKCONTROLS=y
BR2_PACKAGE_QT5QUICKCONTROLS2=y
BR2_PACKAGE_QT5SERIALPORT=y
BR2_PACKAGE_QT5SVG=y
BR2_PACKAGE_QT5XMLPATTERNS=y


BR2_PACKAGE_PYTHON3=y
BR2_PACKAGE_PYTHON_GOBJECT=y
# Target Packages -> Audio and video applications
BR2_PACKAGE_GSTREAMER1=y
# Target Packages -> Networking applications
BR2_PACKAGE_IWD=y
BR2_PACKAGE_RSYNC=y
BR2_PACKAGE_OPENSSH=y
BR2_PACKAGE_CRDA=y
# Target packages -> Development tools
BR2_PACKAGE_PKGCONF=y
# Target packages -> Text editors and viewers
BR2_PACKAGE_NANO=y
# Target packages -> Shell and utilities
BR2_PACKAGE_SUDO=y
```

## package/gcc-arm-none-eabi/Config.in.host
```kconfig
################################################################################
#
# gcc-arm-none-eabi
#
################################################################################

config BR2_PACKAGE_HOST_GCC_ARM_NONE_EABI_SUPPORTS
    bool
    default y
#    depends on BR2_HOSTARCH = "aarch64"
#    depends on BR2_HOSTARCH = "x86_64"


config BR2_PACKAGE_HOST_GCC_ARM_NONE_EABI
    bool "host gcc-arm-none-eabi"
    depends on BR2_PACKAGE_HOST_GCC_ARM_NONE_EABI_SUPPORTS
    help
      The GNU Embedded Toolchain for Arm is a ready-to-use, open source
      suite of tools for C, C++ and Assembly programming targeting Arm
      Cortex-M and Cortex-R family of processors. It includes the GNU
      Compiler (GCC) and is available free of charge directly from Arm
      for embedded software development on Windows, Linux and Mac OS X
      operating systems. 

      https://developer.arm.com/open-source/gnu-toolchain/gnu-rm/downloads
```

## package/klipper/Config.in
```kconfig
config BR2_PACKAGE_KLIPPER
	bool "klipper"
	
	select BR2_PACKAGE_LIBFFI
	select BR2_PACKAGE_LIBUSB
	select BR2_PACKAGE_LIBUSB_DEV
	select BR2_PACKAGE_PYTHON3
	select BR2_PACKAGE_PYTHON_PIP
	select BR2_PACKAGE_PYTHON_CFFI
	select BR2_PACKAGE_PYTHON_SERIAL
	select BR2_PACKAGE_PYTHON_GREENLET
	select BR2_PACKAGE_PYTHON_JINJA2
	select BR2_PACKAGE_PYTHON_CAN
	select BR2_PACKAGE_PYTHON_MARKUPSAFE
	select BR2_PACKAGE_STM32FLASH
	select BR2_PACKAGE_BINUTILS
	select BR2_PACKAGE_BINUTILS_TARGET
	select BR2_PACKAGE_PKGCONF

	help
	  Klipper 3D printer firmware

	  https://github.com/Klipper3d/klipper


if BR2_PACKAGE_KLIPPER

config BR2_PACKAGE_KLIPPER_CONFIG
	string "Klipper configuration file to use?"
	default "$(BR2_EXTERNAL)/package/klipper/klipper.config"
	help
	  Select the klipper config file matching your 3D printing 
	  hardware: uC, port, etc.

endif
```

## package/klipper3d-mainsail/Config.in
```kconfig
config BR2_PACKAGE_KLIPPER3D_MAINSAIL
	bool "klipper3d-mainsail"
	
	select BR2_PACKAGE_NGINX

	help
	  Mainsail is a modern and responsive user interface for Klipper.

	  https://github.com/mainsail-crew/mainsail


if BR2_PACKAGE_KLIPPER3D_MAINSAIL

endif
```

## package/klipper3d-moonraker/Config.in
```kconfig
config BR2_PACKAGE_KLIPPER3D_MOONRAKER
	bool "klipper3d-moonraker"
	
	select BR2_PACKAGE_SUDO
	select BR2_PACKAGE_LIBSODIUM
	select BR2_PACKAGE_KLIPPER3D
	select BR2_PACKAGE_PYTHON_TORNADO
	select BR2_PACKAGE_PYTHON_LMDB
	select BR2_PACKAGE_PYTHON_PILLOW
	select BR2_PACKAGE_PYTHON_SERIAL
	select BR2_PACKAGE_PYTHON_SERIAL_ASYNCIO
	select BR2_PACKAGE_PYTHON_ZEROCONF
	select BR2_PACKAGE_PYTHON_DISTRO
	select BR2_PACKAGE_PYTHON_PAHO_MQTT
	select BR2_PACKAGE_PYTHON_PERIPHERY
	select BR2_PACKAGE_PYTHON_DBUS_NEXT
	select BR2_PACKAGE_PYTHON_INOTIFY_SIMPLE
	select BR2_PACKAGE_PYTHON_STREAMING_FORM_DATA
	select BR2_PACKAGE_PYTHON_SMART_OPEN
	select BR2_PACKAGE_PYTHON_LIBNACL

	help
	  Moonraker is a Python 3 based web server that exposes APIs with which client 
	  applications may use to interact with the 3D printing firmware Klipper.

	  https://github.com/mainsail-crew/mainsail


if BR2_PACKAGE_KLIPPER3D_MOONRAKER

endif
```

## package/klipper3d-wrecklab/Config.in
```kconfig
config BR2_PACKAGE_KLIPPER3D_WRECKLAB
	bool "klipper3d-wrecklab"
	
	select BR2_PACKAGE_KLIPPER3D

	help
	  WrecklabOS is a Klipper3d addon that provide supports for  
	  Wrecklab's printHAT control boards.

	  https://github.com/wreck-lab/wrecklabOS


if BR2_PACKAGE_KLIPPER3D_WRECKLAB

menu "Control Boards"
	depends on BR2_PACKAGE_KLIPPER3D_WRECKLAB

	choice
    	prompt "printHAT"
		config BR2_PACKAGE_KLIPPER3D_WRECKLAB_PHAT1
			tristate "printHAT 1.0"
		config BR2_PACKAGE_KLIPPER3D_WRECKLAB_PHAT2
			tristate "printHAT 2.0"
	endchoice
endmenu

endif
```

## package/python-inotify-simple/Config.in
```kconfig
config BR2_PACKAGE_PYTHON_INOTIFY_SIMPLE
	bool "python-inotify-simple"
	help
	  Inotify simple
```

## package/python-smart-open/Config.in
```kconfig
config BR2_PACKAGE_PYTHON_SMART_OPEN
	bool "python-smart-open"
	help
	  Smart open
```

## package/python-streaming-form-data/Config.in
```kconfig
config BR2_PACKAGE_PYTHON_STREAMING_FORM_DATA
	bool "python-streaming-form-data"
	help
	  Streaming_form_data provides a Python parser for parsing 
	  multipart/form-data input chunks (the encoding used when 
	  submitting data over HTTP through HTML forms)

	  https://github.com/siddhantgoel/streaming-form-data
```
